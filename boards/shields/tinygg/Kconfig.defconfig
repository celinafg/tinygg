## boards/shields/tinygg/Kconfig.defconfig
```kconfig
# Copyright (c) 2020 Pete Johanson, Kurtis Lew
# SPDX-License-Identifier: MIT

if SHIELD_TINYGG_LEFT

config ZMK_KEYBOARD_NAME
    default "Iris"

config ZMK_SPLIT_ROLE_CENTRAL
    default y

endif

if SHIELD_TINYGG_LEFT || SHIELD_TINYGG_RIGHT

config ZMK_SPLIT
    default y

endif
```

## boards/shields/tinygg/Kconfig.shield
```kconfig
# Copyright (c) 2020 Pete Johanson, Kurtis Lew
# SPDX-License-Identifier: MIT

config SHIELD_TINYGG_LEFT
    def_bool $(shields_list_contains,tinygg_left)

config SHIELD_TINYGG_RIGHT
    def_bool $(shields_list_contains,tinygg_right)
```
