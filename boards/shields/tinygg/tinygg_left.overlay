#include "tinygg.dtsi"

&kscan1 {
      col-gpios
            = <&gpio0  0(GPIO_ACTIVE_HIGH | GPIO_PULL_DOWN)>
            , <&gpio0 1 (GPIO_ACTIVE_HIGH | GPIO_PULL_DOWN)>
            , <&gpio0 2 (GPIO_ACTIVE_HIGH | GPIO_PULL_DOWN)>
            , <&gpio0 3 (GPIO_ACTIVE_HIGH | GPIO_PULL_DOWN)>
            , <&gpio0 4 (GPIO_ACTIVE_HIGH | GPIO_PULL_DOWN)>
            , <&gpio1 5 (GPIO_ACTIVE_HIGH | GPIO_PULL_DOWN)>
            ;

};

