/*
 * Copyright (c) 2020
 *
 * SPDX-License-Identifier: MIT
 */

#include "tinygg.dtsi"

&kscan0 {
    col-gpios = <&gpio0 21 GPIO_ACTIVE_HIGH>,
                <&gpio0 20 GPIO_ACTIVE_HIGH>,
                <&gpio0 19 GPIO_ACTIVE_HIGH>,
                <&gpio0 18 GPIO_ACTIVE_HIGH>,
                <&gpio0 15 GPIO_ACTIVE_HIGH>,
                <&gpio0 14 GPIO_ACTIVE_HIGH>,
                <&gpio0 16 GPIO_ACTIVE_HIGH>,
                <&gpio0 10 GPIO_ACTIVE_HIGH>,
                <&gpio0 18 GPIO_ACTIVE_HIGH>,  // Thumb layer column
                <&gpio0 15 GPIO_ACTIVE_HIGH>;  // Thumb space column
    row-gpios = <&gpio0 8 GPIO_ACTIVE_HIGH | GPIO_PULL_DOWN>,
                <&gpio0 7 GPIO_ACTIVE_HIGH | GPIO_PULL_DOWN>,
                <&gpio0 6 GPIO_ACTIVE_HIGH | GPIO_PULL_DOWN>,
                <&gpio0 5 GPIO_ACTIVE_HIGH | GPIO_PULL_DOWN>,
                <&gpio0 9 GPIO_ACTIVE_HIGH | GPIO_PULL_DOWN>; // Thumb row
};
